## drivers/input/touchscreen/FT8722/Kconfig
```kconfig
config TOUCHPANEL_FOCAL_FT8722
	bool "TP Focal_FT8722 IC enable or not for Xiaomi"
	---help---
	say Y to enable driver for Touchpanel using Focal FT8006S-AA
```
